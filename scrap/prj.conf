## CMakeLists.txt
```
# SPDX-License-Identifier: Apache-2.0

cmake_minimum_required(VERSION 3.28.0)

find_package(Zephyr REQUIRED HINTS $ENV{ZEPHYR_BASE})
project(scrap)

FILE(GLOB app_sources src/*.c)
target_sources(app PRIVATE ${app_sources})

include(${ZEPHYR_BASE}/samples/net/common/common.cmake)
```

## Kconfig
```
# Private config options for echo-server sample app

# Copyright (c) 2018 Intel Corporation
# SPDX-License-Identifier: Apache-2.0

mainmenu "Networking echo-server sample application"

config NET_SAMPLE_NUM_HANDLERS
	int "How many connections to serve at the same time"
	default 1
	help
	  Each connection is served by a thread which needs
	  memory. Only increase the value here if really needed.

config NET_SAMPLE_PSK_HEADER_FILE
	string "Header file containing PSK"
	default "dummy_psk.h"
	depends on MBEDTLS_KEY_EXCHANGE_PSK_ENABLED
	help
	  Name of a header file containing a
	  pre-shared key.

config NET_SAMPLE_CERTS_WITH_SC
	bool "Signed certificates"
	depends on NET_SOCKETS_SOCKOPT_TLS
	help
	  Enable this flag, if you are interested to run this
	  application with signed certificates and keys.

config NET_SAMPLE_WEBSOCKET_CONSOLE
	bool "Websocket console support"
	default y if WEBSOCKET_CONSOLE
	help
	  Enable this flag, if you are interested to enable websocket console.
	  You can use the overlay-ws-console.conf to set websocket options.

config NET_SAMPLE_HTTPS_SERVICE
	bool "Enable HTTPS service for the Webconsole"
	default y if NET_SAMPLE_WEBSOCKET_CONSOLE
	depends on NET_SOCKETS_SOCKOPT_TLS || TLS_CREDENTIALS

config NET_CONFIG_NEED_IPV4_BOOT_TIME
	bool "Websocket console support"
	default y

config NET_IPV4_PING
	bool "Websocket console support"
	default y

config NET_ICMPV4
	bool "enable ping"
	default y

config GPIO_ZYNQ
	bool "enable ping"
	default y


config NET_TX_CHECKSUM_OFFLOAD
	bool "enable ping"
	default y

config NET_RX_CHECKSUM_OFFLOAD
	bool "enable ping"
	default y

config NET_DEBUG_DHCPV4
	bool "skata"
	default y

config	NET_ETH_MTU
	int "skata"
	default 1500

config	NET_ETH_PAD_TX
	bool "skata"
	default y

config DEBUG_INFO
	bool  "poutsa"
	default y

config NET_ETHERNET_FORCE_100MBPS
	bool "otinanai"
	default y


if USB_DEVICE_STACK_NEXT

# Source common USB sample options used to initialize new experimental USB
# device stack. The scope of these options is limited to USB samples in project
# tree, you cannot use them in your own application.
source "samples/subsys/usb/common/Kconfig.sample_usbd"

endif

source "samples/net/common/Kconfig"
source "Kconfig.zephyr"
```

## prj.conf
```kconfig
# UDP echo server on port 4242 (src/socket_echo.c)
CONFIG_POSIX_API=y
CONFIG_MAIN_STACK_SIZE=4096

# Networking core
CONFIG_NETWORKING=y
CONFIG_NET_L2_ETHERNET=y
CONFIG_NET_IPV4=y
CONFIG_NET_IPV6=n
CONFIG_NET_UDP=y
CONFIG_NET_TCP=n
CONFIG_NET_ARP=y
CONFIG_NET_SOCKETS=y
CONFIG_NET_MAX_CONTEXTS=4

# No hardware entropy source on Zynq-7000 PS; the network stack needs one
CONFIG_TEST_RANDOM_GENERATOR=y

# Ethernet: Xilinx GEM + generic MII PHY over the GEM MDIO
CONFIG_ETH_DRIVER=y
CONFIG_ETH_XLNX_GEM=y

# Static IPv4 address, applied at boot by net_config.
# Adjust to your LAN. For DHCP instead: set CONFIG_NET_DHCPV4=y and
# leave CONFIG_NET_CONFIG_MY_IPV4_ADDR unset.
CONFIG_NET_CONFIG_SETTINGS=y
CONFIG_NET_CONFIG_NEED_IPV4=y
CONFIG_NET_CONFIG_MY_IPV4_ADDR="192.168.1.98"
CONFIG_NET_CONFIG_MY_IPV4_NETMASK="255.255.255.0"
CONFIG_NET_CONFIG_MY_IPV4_GW="192.168.1.1"
CONFIG_NET_CONFIG_PEER_IPV4_ADDR="192.168.1.3"

# Buffers
CONFIG_NET_PKT_RX_COUNT=32
CONFIG_NET_PKT_TX_COUNT=32
CONFIG_NET_BUF_RX_COUNT=64
CONFIG_NET_BUF_TX_COUNT=64

# Diagnostics: logging (the board defconfig turns it off), net shell, stats.
# Useful shell commands: "net iface", "net stats", "net arp", "net ping <ip>"
CONFIG_LOG=y
CONFIG_LOG_MODE_IMMEDIATE=y
CONFIG_NET_LOG=y
CONFIG_ETHERNET_LOG_LEVEL_INF=y
CONFIG_PHY_LOG_LEVEL_INF=y
CONFIG_NET_CONFIG_LOG_LEVEL_INF=y
CONFIG_NET_SHELL=y
CONFIG_NET_STATISTICS=y
```

## src/socket_echo.c
```c
#include <stdio.h>
#include <stdlib.h>
#include <errno.h>
#include <string.h>

#include <zephyr/kernel.h>
#include <zephyr/net/socket.h>
#include <zephyr/posix/arpa/inet.h>

#include <zephyr/net/net_if.h>
#include <zephyr/net/phy.h>

#define BIND_PORT 4242



int main(void)
{
	int serv;
	struct sockaddr_in bind_addr;
	printf("Booting Echo Server application...\n");
	
	// 1. Wipe and configure the IPv4 socket address structure cleanly
    memset(&bind_addr, 0, sizeof(bind_addr));
    bind_addr.sin_family = AF_INET;
    bind_addr.sin_port = htons(4242);            // Your Echo Server Port
    bind_addr.sin_addr.s_addr = htonl(INADDR_ANY); // <-- FIX: Changes fr
	
	// Explicitly target the IP address configured in your prj.conf
	// if (inet_pton(AF_INET, "192.168.1.98", &bind_addr.sin_addr) <= 0) {
	// 	printf("error: invalid address configuration\n");
	// 	exit(1);
	// }

	// 2. Open the UDP Socket (SOCK_DGRAM)
	serv = socket(AF_INET, SOCK_DGRAM, IPPROTO_UDP);
	if (serv < 0) {
		printf("error: socket: %d\n", errno);
		exit(1);
	}


	// 3. Bind the socket directly
	if (bind(serv, (struct sockaddr *)&bind_addr, sizeof(bind_addr)) < 0) {
		printf("error: bind: %d\n", errno);
		exit(1);
	}

	printf("Proceed\n");

	// 4. Processing Loop
	while (1) {
		char buf[128];
		struct sockaddr_in client_addr;
		socklen_t client_len = sizeof(client_addr);
		printk(".");
		int len = recvfrom(serv, buf, sizeof(buf) - 1, 0,
				   (struct sockaddr *)&client_addr, &client_len);
		if (len > 0) {
			buf[len] = '\0'; // Safe null-termination
			printf("Received UDP packet: %s\n", buf);
			
			// Send it right back to the client
			sendto(serv, buf, len, 0, (struct sockaddr *)&client_addr, client_len);
		}
		k_msleep(10);
	}

	return 0;
}
```
